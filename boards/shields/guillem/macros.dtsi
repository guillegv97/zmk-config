#include <behaviors.dtsi>
#include <dt-bindings/zmk/keys.h>

/ {
    macros {
        // Macro para enviar ñ minúscula (AltGr + N)
        macro_n_tilde: profile_macro_n_tilde {
            compatible = "zmk,behavior-macro";
            #binding-cells = <0>;
            bindings = <&kp N>;
        };

        // Macro para enviar Ñ mayúscula (Shift + AltGr + N)
        macro_N_tilde: profile_macro_N_tilde {
            compatible = "zmk,behavior-macro";
            #binding-cells = <0>;
            bindings = <&kp N>;
        };
    };
};
