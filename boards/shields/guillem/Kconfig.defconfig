## boards/shields/guillem/Kconfig.defconfig
```kconfig
# Copyright (c) 2020 Pete Johanson, Kurtis Lew
# SPDX-License-Identifier: MIT

if SHIELD_GUILLEM_LEFT

config ZMK_KEYBOARD_NAME
    default "Guillem"

config ZMK_SPLIT_ROLE_CENTRAL
    default y

endif

if SHIELD_GUILLEM_LEFT || SHIELD_GUILLEM_RIGHT

config ZMK_SPLIT
    default y

endif
```

## boards/shields/guillem/Kconfig.shield
```kconfig
# Copyright (c) 2020 Pete Johanson, Kurtis Lew
# SPDX-License-Identifier: MIT

config SHIELD_GUILLEM_LEFT
    def_bool $(shields_list_contains,guillem_left)

config SHIELD_GUILLEM_RIGHT
    def_bool $(shields_list_contains,guillem_right)
```
